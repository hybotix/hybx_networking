## Kconfig.projbuild
```kconfig
menu "HybX Networking Configuration"

    config HYBX_WIFI_SSID
        string "WiFi SSID"
        default "hybx_network"
        help
            SSID of the WiFi network to connect to.

    config HYBX_WIFI_PASSWORD
        string "WiFi Password"
        default ""
        help
            WiFi network password. Leave empty for open networks.

    config HYBX_WIFI_MAX_RETRIES
        int "Max WiFi connection retries"
        default 5
        range 1 20
        help
            Number of times to retry WiFi connection before giving up.

    config HYBX_MQTT_URI
        string "MQTT Broker URI"
        default "mqtt://mqtt.local:1883"
        help
            Full URI of the MQTT broker, e.g. mqtt://192.168.1.10:1883
            or mqtts://broker.example.com:8883 for TLS.

    config HYBX_MQTT_CLIENT_ID
        string "MQTT Client ID"
        default "hybx_node_01"
        help
            Unique client identifier for this node on the MQTT broker.

    config HYBX_MQTT_USERNAME
        string "MQTT Username"
        default ""
        help
            Optional MQTT broker username.

    config HYBX_MQTT_PASSWORD
        string "MQTT Password"
        default ""
        help
            Optional MQTT broker password.

    config HYBX_MDNS_HOSTNAME
        string "mDNS Hostname"
        default "hybx-node"
        help
            mDNS hostname for this device (accessible as <hostname>.local).

    config HYBX_SNTP_SERVER_0
        string "Primary NTP Server"
        default "pool.ntp.org"

    config HYBX_SNTP_SERVER_1
        string "Secondary NTP Server"
        default "time.google.com"

    config HYBX_SNTP_SYNC_TIMEOUT_MS
        int "SNTP sync timeout (ms)"
        default 10000
        range 1000 60000
        help
            How long to wait for initial time synchronization.

    config HYBX_ENABLE_MQTT
        bool "Enable MQTT client"
        default y

    config HYBX_ENABLE_MDNS
        bool "Enable mDNS advertisement"
        default y

    config HYBX_ENABLE_SNTP
        bool "Enable SNTP time sync"
        default y

endmenu
```
